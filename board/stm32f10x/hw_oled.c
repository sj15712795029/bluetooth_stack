/******************************************************************************
  * @file    hw_oled.c
  * @author  Yu-ZhongJun
  * @version V0.0.1
  * @date    2018-7-31
  * @brief   oled source file
******************************************************************************/

#include "hw_oled.h"



/********************************** 8x6 lattice ************************************/
const uint8_t font8x6[][6] =
{
    0x00, 0x00, 0x00, 0x00, 0x00, 0x00,// sp
    0x00, 0x00, 0x00, 0x2f, 0x00, 0x00,// !
    0x00, 0x00, 0x07, 0x00, 0x07, 0x00,// "
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    0x14, 0x14, 0x14, 0x14, 0x14, 0x14,// horiz lines
};
/************************************ 16x8 lattice ************************************/
const uint8_t font16x8[]=
{
    0x00,0x00,0x00,0x00,0x00,0x00,0x00,0x00,0x00,0x00,0x00,0x00,0x00,0x00,0x00,0x00,// 0
    0x00,0x00,0x00,0xF8,0x00,0x00,0x00,0x00,0x00,0x00,0x00,0x33,0x30,0x00,0x00,0x00,//! 1
    0x00,0x10,0x0C,0x06,0x10,0x0C,0x06,0x00,0x00,0x00,0x00,0x00,0x00,0x00,0x00,0x00,//" 2
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    0x00,0x06,0x01,0x01,0x02,0x02,0x04,0x04,0x00,0x00,0x00,0x00,0x00,0x00,0x00,0x00,//~ 94
};

/***************************CHINESE******************************/
const uint8_t chinese[][32]=
{
    {0x00,0x00,0xF8,0x88,0x88,0x88,0x88,0xFF,0x88,0x88,0x88,0x88,0xF8,0x00,0x00,0x00},
    {0x00,0x00,0x1F,0x08,0x08,0x08,0x08,0x7F,0x88,0x88,0x88,0x88,0x9F,0x80,0xF0,0x00},/*"电",1*/

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    {0x10,0x08,0x04,0x02,0x01,0x00,0x00,0xFF,0x00,0x00,0x01,0x02,0x04,0x08,0x10,0x00},/*"术",4*/
};

const uint8_t logo[] =
{
    0xFF,0xFF,0xFF,0xFF,0xFF,0xFF,0xFF,0xFF,0xFF,0xFF,0xFF,0xFF,0xFF,0xFF,0xFF,0x8F,
    0x03,0x01,0x03,0x7F,0xFF,0xFF,0xFF,0xFF,0xFF,0xFF,0xFF,0xFF,0xFF,0xFF,0xFF,0xFF,
    0xFF,0xFF,0xFF,0xFF,0xFF,0xFF,0xFF,0xFF,0xFF,0xFF,0xFF,0xFF,0xFF,0xFF,0xFF,0xFF,
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    0xFF,0xFE,0xFF,0xFF,0xFF,0xFF,0xFF,0xFF,0xFF,0xFF,0xFF,0xFF,0xFF,0xFF,0xFF,0xFF,
};



/* FUNC DECLARATION */
static void protocol_iic_start(void);
static void protocol_iic_stop(void);
static void protocol_iic_wait_ack(void);
static void protocol_iic_write_byte(uint8_t byte);
static void protocol_iic_write_cmd(uint8_t command);
static void protocol_iic_write_data(uint8_t data);
static void hw_oled_set_pos(uint8_t col,uint8_t page);
static void hw_oled_write_byte(uint8_t byte,uint8_t cmd);
static uint32_t hw_oled_10_pow(uint8_t power);


/******************************************************************************
 * func name   : hw_oled_display_on
 * para        : NULL
 * return      : hw_oled_display_on result
 * description : To start the OLED display, start the charge pump first
 					 and then send the OLED start command
******************************************************************************/
uint8_t hw_oled_display_on()
{
    /* Open charge pump */
    hw_oled_write_byte(oled_cmd_set_charge_pump,OLED_CMD);
    hw_oled_write_byte(0x14,OLED_CMD);
    /* Turn on OLED display */
    hw_oled_write_byte(oled_cmd_display_on,OLED_CMD);
    return HW_ERR_OK;
}

/******************************************************************************
 * func name   : hw_oled_display_off
 * para        : NULL
 * return      : hw_oled_display_off result
 * description : To turn off the OLED display, send the order first to turn off
 					 the charge pump and then send the OLED off command
******************************************************************************/
uint8_t hw_oled_display_off()
{
    /* Shut off charge pump */
    hw_oled_write_byte(oled_cmd_set_charge_pump,OLED_CMD);
    hw_oled_write_byte(0x10,OLED_CMD);
    /* Turn off OLED display */
    hw_oled_write_byte(oled_cmd_display_off,OLED_CMD);
    return HW_ERR_OK;
}


/******************************************************************************
 * func name   : hw_oled_set_contrast
 * para        : value(IN)		-->contrast.SSD1306 contrast range from 0 to 0xff
 * return      : hw_oled_set_contrast result
 * description : Set SSD1306 OLED contrast
******************************************************************************/
uint8_t hw_oled_set_contrast(uint8_t value)
{
    hw_oled_write_byte(oled_cmd_contrast,OLED_CMD);
    hw_oled_write_byte(value,OLED_CMD);
    return HW_ERR_OK;
}

/******************************************************************************
 * func name   : hw_oled_entry_display_with_ram
 * para        : NULL
 * return      : hw_oled_entry_display_with_ram result
 * description : hw_oled_entry_display_with_ram
******************************************************************************/
uint8_t hw_oled_entry_display_with_ram(void)
{
    hw_oled_write_byte(oled_cmd_entire_display_on_with_ram,OLED_CMD);
    return HW_ERR_OK;
}

/******************************************************************************
 * func name   : hw_oled_entry_display_without_ram
 * para        : NULL
 * return      : hw_oled_entry_display_without_ram result
 * description : hw_oled_entry_display_without_ram
******************************************************************************/
uint8_t hw_oled_entry_display_without_ram(void)
{
    hw_oled_write_byte(oled_cmd_entire_display_on_without_ram,OLED_CMD);
    return HW_ERR_OK;
}

/******************************************************************************
 * func name   : hw_oled_set_normal_display
 * para        : NULL
 * return      : hw_oled_set_normal_display result
 * description : Inverse display of normal/inverse means:
 					 the background color changes with the font color
******************************************************************************/
uint8_t hw_oled_set_normal_display()
{
    hw_oled_write_byte(oled_cmd_normal_display,OLED_CMD);
    return HW_ERR_OK;
}

/******************************************************************************
 * func name   : hw_oled_set_inverse_display
 * para        : NULL
 * return      : hw_oled_set_inverse_display result
 * description : Inverse display of normal/inverse means:
 					 the background color changes with the font color
******************************************************************************/
uint8_t hw_oled_set_inverse_display()
{
    hw_oled_write_byte(oled_cmd_inverse_display,OLED_CMD);
    return HW_ERR_OK;
}


/******************************************************************************
 * func name   : hw_oled_set_horizontal_scroll
 * para        : direct(IN)			--> direct 0->left 1->right
                 start_page(IN)		-->Start Page, SSD1306 pages range from 0 to 7
                 end_page(IN)		-->Endi Page, SSD1306 pages range from 0 to 7
                 interval(IN)		-->time interval
                 						#define SSD1306_TIME_INTEVAL_2FRAME 0x7
											#define SSD1306_TIME_INTEVAL_3FRAME 0x4
											#define SSD1306_TIME_INTEVAL_4FRAME 0x5
											#define SSD1306_TIME_INTEVAL_5FRAME 0x0
											#define SSD1306_TIME_INTEVAL_25FRAME 0x6
											#define SSD1306_TIME_INTEVAL_64FRAME 0x1
											#define SSD1306_TIME_INTEVAL_128FRAME 0x2
											#define SSD1306_TIME_INTEVAL_256FRAME 0x3
 * return      : hw_oled_set_horizontal_scroll result
 * description : Config horizontal_scroll,but not active
******************************************************************************/
uint8_t hw_oled_set_horizontal_scroll(uint8_t direct,uint8_t start_page,uint8_t end_page,uint8_t interval)
{

    if((direct != SSD1306_LEFT_H_SCROLL) && (direct != SSD1306_RIGHT_H_SCROLL))
    {
        return HW_ERR_OLED_INVALID_DIRECT;
    }

    if((start_page > SSD1306_MAX_PAGE) || (end_page > SSD1306_MAX_PAGE))
    {
        return HW_ERR_OLED_INVALID_PAGE;
    }

    if(interval > SSD1306_TIME_INTERVAL_MASK)
    {
        return HW_ERR_OLED_INVALID_INTERVAL;
    }

    hw_oled_scroll_deactive();
    if(direct == SSD1306_RIGHT_H_SCROLL)
    {
        hw_oled_write_byte(oled_cmd_right_hor_scroll,OLED_CMD);
    }
    else
    {
        hw_oled_write_byte(oled_cmd_left_horl_scroll,OLED_CMD);
    }
    hw_oled_write_byte(0x00,OLED_CMD);
    hw_oled_write_byte(start_page,OLED_CMD);
    hw_oled_write_byte(interval,OLED_CMD);
    hw_oled_write_byte(end_page,OLED_CMD);
    hw_oled_write_byte(0x00,OLED_CMD);
    hw_oled_write_byte(0xff,OLED_CMD);
    return HW_ERR_OK;
}

uint8_t hw_oled_set_vertical_scroll(uint8_t direct,uint8_t start_page,uint8_t end_page,uint8_t interval,uint8_t offset)
{

    if((direct != SSD1306_LEFT_V_SCROLL) && (direct != SSD1306_LEFT_V_SCROLL))
    {
        return HW_ERR_OLED_INVALID_DIRECT;
    }

    if((start_page > SSD1306_MAX_PAGE) || (end_page > SSD1306_MAX_PAGE))
    {
        return HW_ERR_OLED_INVALID_PAGE;
    }

    if(interval > SSD1306_TIME_INTERVAL_MASK)
    {
        return HW_ERR_OLED_INVALID_INTERVAL;
    }

    if(offset >= SSD1306_MAX_RAW)
    {
        return HW_ERR_OLED_INVALID_OFFSET;
    }

    hw_oled_scroll_deactive();
    if(direct == SSD1306_LEFT_V_SCROLL)
    {
        hw_oled_write_byte(oled_cmd_ver_left_horl_scroll,OLED_CMD);
    }
    else
    {
        hw_oled_write_byte(oled_cmd_ver_right_hor_scroll,OLED_CMD);
    }
    hw_oled_write_byte(0x00,OLED_CMD);
    hw_oled_write_byte(start_page,OLED_CMD);
    hw_oled_write_byte(interval,OLED_CMD);
    hw_oled_write_byte(end_page,OLED_CMD);
    hw_oled_write_byte(offset,OLED_CMD);
    hw_oled_write_byte(0x00,OLED_CMD);
    hw_oled_write_byte(0xff,OLED_CMD);
    return HW_ERR_OK;
}


/******************************************************************************
 * func name   : hw_oled_scroll_active
 * para        : NULL
 * return      : hw_oled_scroll_active result
 * description : active scroll
******************************************************************************/
uint8_t hw_oled_scroll_active(void)
{
    hw_oled_write_byte(oled_cmd_start_scroll,OLED_CMD);
    return HW_ERR_OK;
}

/******************************************************************************
 * func name   : hw_oled_scroll_deactive
 * para        : NULL
 * return      : hw_oled_scroll_deactive result
 * description : deactive scroll
******************************************************************************/
uint8_t hw_oled_scroll_deactive(void)
{
    hw_oled_write_byte(oled_cmd_stop_scroll,OLED_CMD);
    return HW_ERR_OK;
}


/******************************************************************************
 * func name   : hw_oled_clear
 * para        : NULL
 * return      : hw_oled_clear result
 * description : Clear OLED display
******************************************************************************/
uint8_t hw_oled_clear()
{
    uint8_t page,col;

    /* Clear col from page0 to page7 respectively */
    for(page = 0; page <= SSD1306_MAX_PAGE; page++)
    {
        hw_oled_write_byte (oled_cmd_set_page0_start+page,OLED_CMD);
        hw_oled_write_byte (oled_cmd_lower_col_start_addr,OLED_CMD);
        hw_oled_write_byte (oled_cmd_higher_col_start_addr,OLED_CMD);
        for(col = 0; col < SSD1306_MAX_COL; col++)
        {
            hw_oled_write_byte(0,OLED_DATA);
        }
    }

    return HW_ERR_OK;
}


/******************************************************************************
 * func name   : hw_oled_show_char
 * para        : col(IN)			-->Columns. SSD1306 columns range from 0 to 127
                 page(IN)			-->Page, SSD1306 pages range from 0 to 7
                 show_char(IN)	-->The character to display
                 char_lenght(IN)-->There are currently only two fonts, 16x8 and 8x6,
                 						for the length of the characters to be displayed
 * return      : hw_oled_show_char result
 * description : According to the character
******************************************************************************/
uint8_t hw_oled_show_char(uint8_t col,uint8_t page,uint8_t show_char,uint8_t char_lenght)
{
    uint8_t char_index = 0;
    uint8_t index = 0;

    /* Determine whether the page is legal */
    if(page > SSD1306_MAX_PAGE)
    {
        return HW_ERR_OLED_INVALID_PAGE;
    }
    char_index =show_char-' ';

    /* 16x8 font processing and 8x6 font and expandable font */
    if(char_lenght == FONT16X8_LENGTH)
    {
        /* Determines whether the column to be written can contain this character until the last column */
        if(col + FONT16X8_WEIGHT > SSD1306_MAX_COL)
        {
            return HW_ERR_OLED_INVALID_COL;
        }

        /* Because SSD1306 is 128*64 pixels, there are 8 pages in total,
        so each page is 128 pixels *8 pixels, so 16 pixels is across two pages*/
        hw_oled_set_pos(col,page);
        for(index = 0; index < FONT16X8_WEIGHT; index++)
        {
            hw_oled_write_byte(font16x8[char_index*FONT16X8_LENGTH+index],OLED_DATA);
        }
        hw_oled_set_pos(col,page+1);
        for(index = 0; index < FONT16X8_WEIGHT; index++)
        {
            hw_oled_write_byte(font16x8[char_index*FONT16X8_LENGTH+index+FONT16X8_WEIGHT],OLED_DATA);
        }
    }
    else if(char_lenght == FONT8X6_LENGTH)
    {

        /* Determines whether the column to be written can contain this character until the last column */
        if(col + FONT8X6_WEIGHT > SSD1306_MAX_COL)
        {
            return HW_ERR_OLED_INVALID_COL;
        }
        hw_oled_set_pos(col,page);
        for(index = 0; index < FONT8X6_WEIGHT; index++)
        {
            hw_oled_write_byte(font8x6[char_index][index],OLED_DATA);
        }

    }
    else
    {
        /* TODO:Expansion of word stock */
    }
    return HW_ERR_OK;
}


/******************************************************************************
 * func name   : hw_oled_show_num
 * para        : col(IN)			-->Columns. SSD1306 columns range from 0 to 127
                 page(IN)			-->Page, SSD1306 pages range from 0 to 7
                 num(IN)			-->The digital to display
                 num_len(IN)		-->The number of digits in a number,
                 						for example, 0~9 is 1 bit, 10~99 2 bits
                 char_lenght(IN)-->There are currently only two fonts, 16x8 and 8x6,
                 						for the length of the characters to be displayed
 * return      : hw_oled_show_num result
 * description : According to digital
******************************************************************************/
uint8_t hw_oled_show_num(uint8_t col,uint8_t page,uint32_t num,uint8_t num_len,uint8_t char_lenght)
{
    uint8_t temp_num = 0;
    uint32_t temp_calc = 0;
    uint8_t num_offset = 0;
    while(num_len)
    {
        /*  figure out 10 to the power */
        temp_calc = hw_oled_10_pow(num_len-1);
        /* Figure out the number to write */
        temp_num = num/temp_calc;
        num -= temp_num*temp_calc;
        if(char_lenght == FONT16X8_LENGTH)
        {
            /* Convert the number to ASCII and write, and calculate the offset of the number written */
            hw_oled_show_char(col+num_offset,page,temp_num+'0',char_lenght);
            num_offset += FONT16X8_WEIGHT;

        }
        else if(char_lenght == FONT8X6_LENGTH)
        {
            /* Convert the number to ASCII and write, and calculate the offset of the number written */
            hw_oled_show_char(col+num_offset,page,temp_num+'0',char_lenght);
            num_offset += FONT8X6_WEIGHT;
        }
        else
        {
            /* TODO:Expansion of word stock */
        }

        num_len--;
    }

    return HW_ERR_OK;
}

/******************************************************************************
 *	函数名:	hw_oled_show_string
 * 参数:  	col(IN)				-->列，SSD1306列的范围是0~127
 				page(IN)				-->页，SSD1306页的范围是0~7
 				string(IN)			-->要显示的字符串
 				char_lenght(IN)		-->要显示的字符的长度,目前只有两种字体，16x8,8x6
 * 返回值: 	hw_oled_show_string结果
 * 描述:		显示字符串
******************************************************************************/
uint8_t hw_oled_show_string(uint8_t col,uint8_t page,uint8_t *string,uint8_t char_lenght)
{
    uint8_t index = 0;
    uint8_t offset = 0;
    /* 直到取到字符串最后一个字符 */
    while (string[index]!='\0')
    {
        if(char_lenght == FONT16X8_LENGTH)
        {
            hw_oled_show_char(col + offset,page,string[index],char_lenght);
            offset += FONT16X8_WEIGHT;

        }
        else if(char_lenght == FONT8X6_LENGTH)
        {
            hw_oled_show_char(col + offset,page,string[index],char_lenght);
            offset += FONT8X6_WEIGHT;
        }
        else
        {
            /* 待扩充 */
        }
        index++;
    }
    return HW_ERR_OK;
}

/******************************************************************************
 *	函数名:	hw_oled_show_chinese
 * 参数:  	col(IN)				-->列，SSD1306列的范围是0~127
 				page(IN)				-->页，SSD1306页的范围是0~7
 				string(IN)			-->要显示的字符串
 				char_lenght(IN)		-->要显示的字符的长度,目前只有两种字体，16x8,8x6
 * 返回值: 	hw_oled_show_chinese结果
 * 描述:		显示字符串
******************************************************************************/
uint8_t hw_oled_show_chinese(uint8_t col,uint8_t page,uint8_t chinese_index)
{
    uint8_t index,adder=0;

    if(page > SSD1306_MAX_PAGE)
    {
        return HW_ERR_OLED_INVALID_PAGE;
    }
    hw_oled_set_pos(col,page);
    for(index=0; index<16; index++)
    {
        hw_oled_write_byte(chinese[2*chinese_index][index],OLED_DATA);
        adder+=1;
    }
    hw_oled_set_pos(col,page+1);
    for(index=0; index<16; index++)
    {
        hw_oled_write_byte(chinese[2*chinese_index+1][index],OLED_DATA);
        adder+=1;
    }

    return HW_ERR_OK;
}

/******************************************************************************
 *	函数名:	hw_oled_draw_bmp
 * 参数:  	col_start(IN)		-->起始列
 				page_start(IN)		-->起始页
 				col_end(IN)			-->结束列
 				page_end(IN)			-->结束页
 				bmp(IN)				-->bmp数据
 * 返回值: 	hw_oled_draw_bmp结果
 * 描述:		显示bmp图片
******************************************************************************/
uint8_t hw_oled_draw_bmp(uint8_t col_start,uint8_t page_start,uint8_t col_end,uint8_t page_end,uint8_t *bmp)
{
    uint32_t j=0;
    uint8_t col_temp,temp_page;

    for(temp_page = page_start; temp_page < page_end; temp_page++)
    {
        hw_oled_set_pos(col_start,temp_page);
        for(col_temp = col_start; col_temp < col_end; col_temp++)
        {
            hw_oled_write_byte(bmp[j++],OLED_DATA);
        }
    }
    return HW_ERR_OK;
}


/******************************************************************************
 *	函数名:	hw_oled_init
 * 参数:  	NULL
 * 返回值: 	oled init结果
 * 描述:		OLED的初始化，采用软件模拟IIC来驱动SSD1306，用到的PIN为:
 				SSD1306_SDA_PIN-->IIC SDA,SSD1306_SCL_PIN-->IIC SCL
******************************************************************************/
uint8_t hw_oled_init()
{
    GPIO_InitTypeDef  GPIO_InitStructure;

    RCC_APB2PeriphClockCmd(SSD1306_PERIPH_CLK | RCC_APB2Periph_AFIO, ENABLE);
    GPIO_PinRemapConfig(GPIO_Remap_SWJ_NoJTRST,ENABLE);
    GPIO_InitStructure.GPIO_Pin = SSD1306_SCL_PIN|SSD1306_SDA_PIN;
    GPIO_InitStructure.GPIO_Mode = GPIO_Mode_Out_PP;
    GPIO_InitStructure.GPIO_Speed = GPIO_Speed_50MHz;
    GPIO_Init(SSD1306_SCL_GPIO, &GPIO_InitStructure);
    GPIO_SetBits(SSD1306_SCL_GPIO,SSD1306_SCL_PIN|SSD1306_SDA_PIN);

    /* 延时200ms */
    hw_delay_ms(200);

    hw_oled_write_byte(oled_cmd_set_multiplex_ratio,OLED_CMD);			/* 设置复用率为32 */
    hw_oled_write_byte(0x3F,OLED_CMD);

    hw_oled_write_byte(oled_cmd_set_display_offset,OLED_CMD);			/* 设置偏移量为0 */
    hw_oled_write_byte(0x00,OLED_CMD);

    hw_oled_write_byte(oled_cmd_set_start_line_lowset,OLED_CMD);		/* 设置起始行地址 */

    hw_oled_write_byte(oled_cmd_set_remap1,OLED_CMD);					/* 设置重映射 */

    hw_oled_write_byte(oled_cmd_set_com_remap_scan,OLED_CMD);		/* 设置从COM[N-1]扫描到COM0 */

    hw_oled_write_byte(oled_cmd_set_compin_hw_conf,OLED_CMD);		/* 设置列引脚硬件配置 */
    hw_oled_write_byte(0x12,OLED_CMD);

    hw_oled_write_byte(oled_cmd_contrast,OLED_CMD);						/* 设置对比度为 */
    hw_oled_write_byte(0xff,OLED_CMD);

    hw_oled_write_byte(oled_cmd_entire_display_on_with_ram,OLED_CMD);

    hw_oled_write_byte(oled_cmd_normal_display,OLED_CMD);				/* 设置为正常显示 */

    hw_oled_write_byte(oled_cmd_set_clk_div_osc_freq,OLED_CMD);		/* 设置显示时钟分频值/震荡频率 */
    hw_oled_write_byte(0x80,OLED_CMD);

    hw_oled_write_byte(oled_cmd_set_charge_pump,OLED_CMD);
    hw_oled_write_byte(0x14,OLED_CMD);

    hw_oled_write_byte(oled_cmd_display_on,OLED_CMD);					/* 启动显示 */

    hw_oled_clear();

    return HW_ERR_OK;

}


/******************************************************************************
 *	函数名:	protocol_iic_start
 * 参数:  	NULL
 * 返回值: 	NULL
 * 描述:		software模拟IIC起始信号，信号时序是
 				SCL高电平，SDA从高到低跳变
******************************************************************************/
static void protocol_iic_start()
{
    IIC_SCLK_HIGH;
    IIC_SDIN_HIGH;
    IIC_SDIN_LOW;
}

/******************************************************************************
 *	函数名:	protocol_iic_stop
 * 参数:  	NULL
 * 返回值: 	NULL
 * 描述:		software模拟IIC停止信号，信号时序是
 				SCL高电平，SDA从低到高跳变
******************************************************************************/
static void protocol_iic_stop()
{
    IIC_SCLK_HIGH;
    IIC_SDIN_LOW;
    IIC_SDIN_HIGH;

}

/******************************************************************************
 *	函数名:	protocol_iic_wait_ack
 * 参数:  		NULL
 * 返回值: 	NULL
 * 描述:		software模拟IIC等待应答
******************************************************************************/
static void protocol_iic_wait_ack()
{
    IIC_SCLK_HIGH ;
    IIC_SCLK_LOW;
}

/******************************************************************************
 *	函数名:	protocol_iic_write_byte
 * 参数:  	byte(IN)		-->要写的数据
 * 返回值: 	NULL
 * 描述:		软件模拟IIC写byte
******************************************************************************/
static void protocol_iic_write_byte(uint8_t byte)
{
    uint8_t i;
    uint8_t m,da;
    da=byte;
    IIC_SCLK_LOW;
    for(i=0; i<8; i++)
    {
        m=da;
        m=m&HIGH_BIT_MASK;
        if(m==HIGH_BIT_MASK)
        {
            IIC_SDIN_HIGH;
        }
        else IIC_SDIN_LOW;
        da=da<<1;
        IIC_SCLK_HIGH;
        IIC_SCLK_LOW;
    }

}

/******************************************************************************
 *	函数名:	protocol_iic_write_cmd
 * 参数:  	command(IN)		-->要写的command
 * 返回值: 	NULL
 * 描述:		软件模拟IIC写命令
******************************************************************************/
static void protocol_iic_write_cmd(uint8_t command)
{
    protocol_iic_start();
    protocol_iic_write_byte(SSD1306_SLAVE_ADDR | SSD1306_IIC_WRITE);
    protocol_iic_wait_ack();
    protocol_iic_write_byte(SSD1306_IIC_CMD_MASK);
    protocol_iic_wait_ack();
    protocol_iic_write_byte(command);
    protocol_iic_wait_ack();
    protocol_iic_stop();
}

/******************************************************************************
 *	函数名:	protocol_iic_write_data
 * 参数:  	data(IN)		-->要写的data
 * 返回值: 	NULL
 * 描述:		软件模拟IIC写数据
******************************************************************************/
static void protocol_iic_write_data(uint8_t data)
{
    protocol_iic_start();
    protocol_iic_write_byte(SSD1306_SLAVE_ADDR | SSD1306_IIC_WRITE);
    protocol_iic_wait_ack();
    protocol_iic_write_byte(SSD1306_IIC_DAT_MASK);
    protocol_iic_wait_ack();
    protocol_iic_write_byte(data);
    protocol_iic_wait_ack();
    protocol_iic_stop();
}

/******************************************************************************
 *	函数名:	hw_oled_set_pos
 * 参数:  		col(IN)		-->要写的列
 				page(IN)		-->要写的页
 * 返回值: 	NULL
 * 描述:		设置OLED要写的pos
******************************************************************************/
static void hw_oled_set_pos(uint8_t col,uint8_t page)
{
    hw_oled_write_byte(oled_cmd_set_page0_start+page,OLED_CMD);
    hw_oled_write_byte((col&0x0f) | oled_cmd_lower_col_start_addr,OLED_CMD);
    hw_oled_write_byte(((col&0xf0)>>4)|oled_cmd_higher_col_start_addr,OLED_CMD);
}

/******************************************************************************
 *	函数名:	hw_oled_write_byte
 * 参数:  		byte(IN)		-->要写的byte
 				cmd(IN)		-->是否是cmd
 * 返回值: 	NULL
 * 描述:		OLED写byte
******************************************************************************/
static void hw_oled_write_byte(uint8_t byte,uint8_t cmd)
{
    if(cmd)
    {
        /* 通过iic发送command */
        protocol_iic_write_cmd(byte);
    }
    else
    {
        /* 通过iic发送data */
        protocol_iic_write_data(byte);
    }
}

/******************************************************************************
 *	函数名:	hw_oled_10_pow
 * 参数:  		power(IN)		-->10的多少次方
 * 返回值: 	10的power次方值
 * 描述:		计算10的次方数
******************************************************************************/
static uint32_t hw_oled_10_pow(uint8_t power)
{
    uint32_t result = 1;
    while(power--)
    {
        result *= 10;
    }
    return result;
}

